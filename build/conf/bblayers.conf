## build/conf/bblayers.conf
```bitbake
# POKY_BBLAYERS_CONF_VERSION is increased each time build/conf/bblayers.conf
# changes incompatibly
POKY_BBLAYERS_CONF_VERSION = "2"

BBPATH = "${TOPDIR}"
BBFILES ?= ""

YOCTOROOT = "${@os.path.abspath(os.path.join("${TOPDIR}", os.pardir))}"

BBLAYERS ?= " \
  ${YOCTOROOT}/poky/meta \
  ${YOCTOROOT}/poky/meta-poky \
  ${YOCTOROOT}/poky/meta-yocto-bsp \
  ${YOCTOROOT}/meta-intel \
  ${YOCTOROOT}/meta-sunxi \
  ${YOCTOROOT}/meta-arm/meta-arm-toolchain \
  ${YOCTOROOT}/meta-arm/meta-arm \
  ${YOCTOROOT}/meta-openembedded/meta-oe \
  ${YOCTOROOT}/meta-openembedded/meta-python \
  ${YOCTOROOT}/meta-openembedded/meta-networking \
  ${YOCTOROOT}/meta-webkit \
  ${YOCTOROOT}/meta-cltkiosk \
  "
```

## meta-cltkiosk/conf/distro/cltkiosk.conf
```bitbake
# Base on poky configuration
require conf/distro/poky.conf

DISTRO = "cltkiosk"
DISTRO_NAME = "CLT Kiosk"
DISTRO_DESCRIPTION = "Demo-Distribution zum Talk 'Imagebau mit Yocto: Ein Einstieg für Neugierige' auf den Chemnitzer Linux-Tagen 2025"

DISTRO_VERSION = "0.1"
DISTRO_CODENAME = "Tux"

DISTRO_FEATURES:append = " "
DISTRO_FEATURES:remove = " x11 vulkan alsa bluetooth pcmcia nfs zeroconf 3g nfc"

PREFERRED_PROVIDER_virtual/wpebackend = "wpebackend-fdo"

PACKAGECONFIG:remove:pn-wpewebkit:cubietruck = "speech-synthesis"
PACKAGECONFIG:remove:pn-wpewebkit:cubietruck = "jit"

PACKAGECONFIG:remove:pn-wpewebkit:intel-core2-32 = "speech-synthesis"
PACKAGECONFIG:remove:pn-wpewebkit:intel-corei7-64 = "speech-synthesis"
```

## meta-cltkiosk/conf/layer.conf
```bitbake
# We have a conf and classes directory, add to BBPATH
BBPATH .= ":${LAYERDIR}"

# We have recipes-* directories, add to BBFILES
BBFILES += "${LAYERDIR}/recipes-*/*/*.bb \
            ${LAYERDIR}/recipes-*/*/*.bbappend"

BBFILES_DYNAMIC += " \
    sunxi:${LAYERDIR}/dynamic-layers/sunxi/recipes-*/*/*.bb \
    sunxi:${LAYERDIR}/dynamic-layers/sunxi/recipes-*/*/*.bbappend \
    intel:${LAYERDIR}/dynamic-layers/intel/recipes-*/*/*.bb \
    intel:${LAYERDIR}/dynamic-layers/intel/recipes-*/*/*.bbappend \
"

BBFILE_COLLECTIONS += "cltkiosk"
BBFILE_PATTERN_cltkiosk = "^${LAYERDIR}/"
BBFILE_PRIORITY_cltkiosk = "6"

LAYERDEPENDS_cltkiosk = "core networking-layer"
LAYERSERIES_COMPAT_cltkiosk = "scarthgap"

# allow sops to be called from recipes
HOSTTOOLS += "sops"
```
